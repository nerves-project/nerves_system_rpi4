/dts-v1/;
/plugin/;

/{
	compatible = "brcm,bcm2835";

	fragment@0 {
		target = <&rmem>;
		__overlay__ {
			/* See arch/arm/boot/dts/bcm283x.dtsi and bcm2711.dtsi
			 * for rmem (reserved-memory) definitions. */
			#address-cells = <2>;
			#size-cells = <1>;
			ranges;

			ramoops@f000000 {
				compatible = "ramoops";
				reg = <0 0xf000000 0x100000>; /* 1 MB */
				ecc-size = <16>;
				record-size = <0x20000>; /* 128kB */
				console-size = <0x20000>;
				ftrace-size = <0>;
				pmsg-size = <0x20000>;
			};
		};
	};
};
