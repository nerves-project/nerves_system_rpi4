## nerves_defconfig
```kconfig
BR2_aarch64=y
BR2_cortex_a72=y
BR2_TAR_OPTIONS="--no-same-owner"
BR2_PRIMARY_SITE="https://ly-archive.iotcloud.io"
BR2_BACKUP_SITE="http://dl.nerves-project.org"
BR2_ENABLE_DEBUG=y
BR2_OPTIMIZE_2=y
BR2_GLOBAL_PATCH_DIR="${BR2_EXTERNAL_NERVES_PATH}/patches ${NERVES_DEFCONFIG_DIR}/patches"
BR2_REPRODUCIBLE=y
BR2_TOOLCHAIN_EXTERNAL=y
BR2_TOOLCHAIN_EXTERNAL_CUSTOM=y
BR2_TOOLCHAIN_EXTERNAL_DOWNLOAD=y
BR2_TOOLCHAIN_EXTERNAL_URL="https://github.com/nerves-project/toolchains/releases/download/v1.5.0/nerves_toolchain_aarch64_nerves_linux_gnu-linux_x86_64-1.5.0-B25501B.tar.xz"
BR2_TOOLCHAIN_EXTERNAL_CUSTOM_PREFIX="aarch64-nerves-linux-gnu"
BR2_TOOLCHAIN_EXTERNAL_GCC_10=y
BR2_TOOLCHAIN_EXTERNAL_HEADERS_4_19=y
BR2_TOOLCHAIN_EXTERNAL_CUSTOM_GLIBC=y
# BR2_TOOLCHAIN_EXTERNAL_INET_RPC is not set
BR2_TOOLCHAIN_EXTERNAL_CXX=y
BR2_TOOLCHAIN_EXTERNAL_OPENMP=y
BR2_ROOTFS_SKELETON_CUSTOM=y
BR2_ROOTFS_SKELETON_CUSTOM_PATH="${BR2_EXTERNAL_NERVES_PATH}/board/nerves-common/skeleton"
BR2_INIT_NONE=y
BR2_ROOTFS_DEVICE_CREATION_DYNAMIC_EUDEV=y
BR2_ROOTFS_DEVICE_TABLE="${BR2_EXTERNAL_NERVES_PATH}/board/nerves-common/device_table.txt"
BR2_ENABLE_LOCALE_WHITELIST="locale-archive"
BR2_GENERATE_LOCALE="en_US.UTF-8"
BR2_ROOTFS_USERS_TABLES="${NERVES_DEFCONFIG_DIR}/users_table.txt"
BR2_ROOTFS_OVERLAY="${BR2_EXTERNAL_NERVES_PATH}/board/nerves-common/rootfs_overlay ${NERVES_DEFCONFIG_DIR}/rootfs_overlay"
BR2_ROOTFS_POST_BUILD_SCRIPT="${NERVES_DEFCONFIG_DIR}/post-build.sh ${BR2_EXTERNAL_NERVES_PATH}/board/nerves-common/post-build.sh ${NERVES_DEFCONFIG_DIR}/post-build-symlinks.sh"
BR2_ROOTFS_POST_FAKEROOT_SCRIPT="${NERVES_DEFCONFIG_DIR}/post-fakeroot.sh"
BR2_ROOTFS_POST_IMAGE_SCRIPT="${NERVES_DEFCONFIG_DIR}/post-createfs.sh"
BR2_LINUX_KERNEL=y
BR2_LINUX_KERNEL_CUSTOM_GIT=y
BR2_LINUX_KERNEL_CUSTOM_REPO_URL="https://github.com/raspberrypi/linux.git"
BR2_LINUX_KERNEL_CUSTOM_REPO_VERSION="606d1fc3bc97a8be1d21e143ca88f3ba085ddef1"
BR2_LINUX_KERNEL_PATCH="${NERVES_DEFCONFIG_DIR}/linux"
BR2_LINUX_KERNEL_USE_CUSTOM_CONFIG=y
BR2_LINUX_KERNEL_CUSTOM_CONFIG_FILE="${NERVES_DEFCONFIG_DIR}/linux-5.10.defconfig"
BR2_LINUX_KERNEL_CONFIG_FRAGMENT_FILES="${NERVES_DEFCONFIG_DIR}/linux_additional.defconfig"
BR2_LINUX_KERNEL_XZ=y
BR2_LINUX_KERNEL_DTS_SUPPORT=y
BR2_LINUX_KERNEL_INTREE_DTS_NAME="broadcom/bcm2711-rpi-4-b broadcom/bcm2711-rpi-cm4 broadcom/bcm2711-rpi-400"
BR2_LINUX_KERNEL_CUSTOM_DTS_PATH="${NERVES_DEFCONFIG_DIR}/ramoops.dts"
BR2_LINUX_KERNEL_NEEDS_HOST_OPENSSL=y
BR2_PACKAGE_BUSYBOX_CONFIG="${BR2_EXTERNAL_NERVES_PATH}/board/nerves-common/busybox.config"
BR2_PACKAGE_BUSYBOX_CONFIG_FRAGMENT_FILES="${NERVES_DEFCONFIG_DIR}/busybox_defconfig"
BR2_PACKAGE_BUSYBOX_SHOW_OTHERS=y
BR2_PACKAGE_ESPEAK=y
BR2_PACKAGE_BZIP2=y
BR2_PACKAGE_GZIP=y
BR2_PACKAGE_UNZIP=y
BR2_PACKAGE_XZ=y
BR2_PACKAGE_PV=y
BR2_PACKAGE_E2FSPROGS=y
# BR2_PACKAGE_E2FSPROGS_FSCK is not set
BR2_PACKAGE_F2FS_TOOLS=y
BR2_PACKAGE_FBSET=y
BR2_PACKAGE_FBV=y
# BR2_PACKAGE_FBV_JPEG is not set
# BR2_PACKAGE_FBV_GIF is not set
BR2_PACKAGE_MESA3D=y
BR2_PACKAGE_MESA3D_GALLIUM_DRIVER_SWRAST=y
BR2_PACKAGE_MESA3D_GALLIUM_DRIVER_V3D=y
BR2_PACKAGE_MESA3D_GALLIUM_DRIVER_VC4=y
BR2_PACKAGE_MESA3D_OPENGL_ES=y
BR2_PACKAGE_LINUX_FIRMWARE=y
BR2_PACKAGE_LINUX_FIRMWARE_BRCM_BCM43XXX=y
BR2_PACKAGE_LINUX_FIRMWARE_RALINK_RT2XX=y
BR2_PACKAGE_RPI_BT_FIRMWARE=y
BR2_PACKAGE_RPI_FIRMWARE=y
BR2_PACKAGE_RPI_FIRMWARE_CUSTOM_VERSION="536baf33ae9007d027bffc8f42cb603664ecb5c4"
BR2_PACKAGE_RPI_FIRMWARE_VARIANT_PI4_X=y
BR2_PACKAGE_CRYPTSETUP=y
BR2_PACKAGE_DFU_UTIL=y
BR2_PACKAGE_EUDEV_RULES_GEN=y
BR2_PACKAGE_I2C_TOOLS=y
# BR2_PACKAGE_LVM2_STANDARD_INSTALL is not set
BR2_PACKAGE_PIGPIO=y
# BR2_PACKAGE_RNG_TOOLS_JITTERENTROPY_LIBRARY is not set
BR2_PACKAGE_RPI_USERLAND=y
BR2_PACKAGE_UHUBCTL=y
BR2_PACKAGE_PYTHON3=y
BR2_PACKAGE_PYTHON3_PY_PYC=y
BR2_PACKAGE_PYTHON3_SSL=y
BR2_PACKAGE_PYTHON_ESPTOOL=y
BR2_PACKAGE_PYTHON_SETUPTOOLS=y
BR2_PACKAGE_CA_CERTIFICATES=y
BR2_PACKAGE_CRYPTODEV=y
BR2_PACKAGE_LIBP11=y
BR2_PACKAGE_UNIXODBC=y
BR2_PACKAGE_LIBFTDI1=y
BR2_PACKAGE_LIBCURL=y
BR2_PACKAGE_LIBCURL_CURL=y
BR2_PACKAGE_LIBMNL=y
BR2_PACKAGE_LIBSOCKETCAN=y
BR2_PACKAGE_OPENZWAVE=y
BR2_PACKAGE_LIBICAL=y
BR2_PACKAGE_P11_KIT=y
BR2_PACKAGE_BLUEZ5_UTILS=y
BR2_PACKAGE_BLUEZ5_UTILS_CLIENT=y
BR2_PACKAGE_BLUEZ5_UTILS_TOOLS=y
BR2_PACKAGE_BLUEZ5_UTILS_DEPRECATED=y
BR2_PACKAGE_CAN_UTILS=y
BR2_PACKAGE_DNSMASQ=y
BR2_PACKAGE_DNSMASQ_DNSSEC=y
BR2_PACKAGE_HOSTAPD=y
BR2_PACKAGE_HOSTAPD_EAP=y
BR2_PACKAGE_HOSTAPD_WPS=y
# BR2_PACKAGE_HOSTAPD_VLAN is not set
BR2_PACKAGE_IPROUTE2=y
BR2_PACKAGE_IPTABLES=y
BR2_PACKAGE_SOCAT=y
BR2_PACKAGE_SOCKETCAND=y
BR2_PACKAGE_WIRELESS_REGDB=y
BR2_PACKAGE_WPA_SUPPLICANT=y
BR2_PACKAGE_WPA_SUPPLICANT_AP_SUPPORT=y
BR2_PACKAGE_WPA_SUPPLICANT_MESH_NETWORKING=y
BR2_PACKAGE_WPA_SUPPLICANT_AUTOSCAN=y
BR2_PACKAGE_WPA_SUPPLICANT_HOTSPOT=y
BR2_PACKAGE_WPA_SUPPLICANT_DEBUG_SYSLOG=y
BR2_PACKAGE_WPA_SUPPLICANT_WPS=y
BR2_PACKAGE_WPA_SUPPLICANT_WPA3=y
BR2_PACKAGE_WPA_SUPPLICANT_PASSPHRASE=y
BR2_PACKAGE_WPA_SUPPLICANT_CTRL_IFACE=y
BR2_PACKAGE_INOTIFY_TOOLS=y
BR2_PACKAGE_UTIL_LINUX_BINARIES=y
BR2_PACKAGE_UTIL_LINUX_WIPEFS=y
# BR2_TARGET_ROOTFS_TAR is not set
BR2_TARGET_UBOOT=y
BR2_TARGET_UBOOT_USE_CUSTOM_CONFIG=y
BR2_TARGET_UBOOT_CUSTOM_CONFIG_FILE="${NERVES_DEFCONFIG_DIR}/uboot/uboot.defconfig"
BR2_TARGET_UBOOT_NEEDS_DTC=y
BR2_PACKAGE_HOST_PYTHON3=y
BR2_PACKAGE_HOST_PYTHON3_SSL=y
BR2_NERVES_SYSTEM_NAME="ly11_system_rpi4"
BR2_NERVES_ADDITIONAL_IMAGE_FILES="${NERVES_DEFCONFIG_DIR}/fwup.conf ${NERVES_DEFCONFIG_DIR}/cmdline.txt ${NERVES_DEFCONFIG_DIR}/config.txt"
BR2_PACKAGE_NBTTY=y
BR2_PACKAGE_NERVES_CONFIG=y
BR2_PACKAGE_YUBICO_PIV_TOOL=y
BR2_PACKAGE_AVRDUDE_LY=y
BR2_PACKAGE_OPENOCD_11=y
BR2_PACKAGE_OPENOCD_11_CMSIS_DAP=y
BR2_PACKAGE_OPENOCD_11_FTDI=y
BR2_PACKAGE_OPENOCD_11_STLINK=y
BR2_PACKAGE_OPENOCD_11_JLINK=y
BR2_PACKAGE_OPENOCD_11_XDS110=y
BR2_PACKAGE_OPENOCD_ESP32=y
BR2_PACKAGE_OPENOCD_NRF9160=y
BR2_PACKAGE_OPENOCD_PN7362=y
BR2_PACKAGE_LIBFREEFARE_LY=y
BR2_PACKAGE_OPENOCD_ZEPHYR=y
BR2_PACKAGE_OPENOCD_CYPRESS=y
BR2_PACKAGE_PICKLE=y
BR2_PACKAGE_PYTHON_PYOCD=y
```

## package/libfreefare_ly/Config.in
```kconfig
config BR2_PACKAGE_LIBFREEFARE_LY
	bool "libfreefare_ly"
	depends on BR2_TOOLCHAIN_HAS_THREADS # libusb
	select BR2_PACKAGE_OPENSSL
	select BR2_PACKAGE_LIBNFC_LY
	help
	  Library for high level manipulation of MIFARE cards.

	  http://nfc-tools.org/index.php?title=Libfreefare

comment "libfreefare needs a toolchain w/ threads"
	depends on !BR2_TOOLCHAIN_HAS_THREADS
```

## package/libnfc_ly/Config.in
```kconfig
config BR2_PACKAGE_LIBNFC_LY
	bool "libnfc_ly"
	depends on BR2_TOOLCHAIN_HAS_THREADS # libusb
	select BR2_PACKAGE_LIBUSB
	select BR2_PACKAGE_LIBUSB_COMPAT
	help
	  Public platform independent Near Field Communication (NFC)
	  library.

	  http://www.libnfc.org/

comment "libnfc needs a toolchain w/ threads"
	depends on !BR2_TOOLCHAIN_HAS_THREADS
```

## package/openocd_cypress/Config.in
```kconfig
config BR2_PACKAGE_OPENOCD_CYPRESS
        bool "openocd_cypress"
        depends on BR2_TOOLCHAIN_HAS_THREADS #
        select BR2_PACKAGE_LIBUSB
        select BR2_PACKAGE_LIBUSB_COMPAT
        select BR2_PACKAGE_LIBFTDI
        select BR2_PACKAGE_HIDAPI
        help
           OpenOCD for Cypress
```

## package/openocd_esp32/Config.in
```kconfig
config BR2_PACKAGE_OPENOCD_ESP32
        bool "openocd_esp32"
        depends on BR2_TOOLCHAIN_HAS_THREADS #
        select BR2_PACKAGE_LIBUSB
        select BR2_PACKAGE_LIBUSB_COMPAT
        select BR2_PACKAGE_LIBFTDI
        help
           OpenOCD for esp32
```

## package/openocd_ly/Config.in
```kconfig
config BR2_PACKAGE_OPENOCD_LY
        bool "openocd_ly"
        depends on BR2_TOOLCHAIN_HAS_THREADS #
        select BR2_PACKAGE_LIBUSB
        select BR2_PACKAGE_LIBUSB_COMPAT
        select BR2_PACKAGE_LIBFTDI
        select BR2_PACKAGE_HIDAPI
        help
           OpenOCD
```

## package/openocd_nrf9160/Config.in
```kconfig
config BR2_PACKAGE_OPENOCD_NRF9160
        bool "openocd_nrf9160"
        depends on BR2_TOOLCHAIN_HAS_THREADS #
        select BR2_PACKAGE_LIBUSB
        select BR2_PACKAGE_LIBUSB_COMPAT
        select BR2_PACKAGE_LIBFTDI
        help
           OpenOCD for nrf9160
```

## package/openocd_pn7362/Config.in
```kconfig
config BR2_PACKAGE_OPENOCD_PN7362
        bool "openocd_pn7362"
        depends on BR2_TOOLCHAIN_HAS_THREADS #
        select BR2_PACKAGE_LIBUSB
        select BR2_PACKAGE_LIBUSB_COMPAT
        select BR2_PACKAGE_LIBFTDI
        help
           OpenOCD for PN7362
```

## package/openocd_zephyr/Config.in
```kconfig
config BR2_PACKAGE_OPENOCD_ZEPHYR
        bool "openocd_zephyr"
        depends on BR2_TOOLCHAIN_HAS_THREADS #
        select BR2_PACKAGE_LIBUSB
        select BR2_PACKAGE_LIBUSB_COMPAT
        select BR2_PACKAGE_LIBFTDI
        select BR2_PACKAGE_HIDAPI
        help
           OpenOCD for Zephyr
```

## package/pickle/Config.in
```kconfig
config BR2_PACKAGE_PICKLE
	bool "pickle"
	depends on BR2_TOOLCHAIN_HAS_THREADS
	help
	  pickle is a programmer for Microchip PIC microcontrollers

	  http://hg.kewl.org/pub/pickle
```

## package/python-intelhex/Config.in
```kconfig
config BR2_PACKAGE_PYTHON_INTELHEX
	bool "python-intelhex"
  depends on BR2_PACKAGE_PYTHON3
	help
    Python library for Intel HEX files manipulations
```

## package/python-intervaltree/Config.in
```kconfig
config BR2_PACKAGE_PYTHON_INTERVALTREE
	bool "python-intervaltree"
	select BR2_PACKAGE_PYTHON_SORTEDCONTAINERS # runtime
	help
	  Editable interval tree data structure for Python 2 and 3.

	  https://github.com/chaimleib/intervaltree
```

## package/python-libusb/Config.in
```kconfig
config BR2_PACKAGE_PYTHON_LIBUSB
	bool "python-libusb"
	help
	  Python binding for the libusb C library (ctypes/cffi-based
	  libusb).

	  https://pypi.org/project/libusb/
```

## package/python-prettytable/Config.in
```kconfig
config BR2_PACKAGE_PYTHON_PRETTYTABLE
	bool "python-prettytable"
	help
	  A simple Python library for easily displaying tabular data in a visually appealing ASCII table format
```

## package/python-pyocd/Config.in
```kconfig
config BR2_PACKAGE_PYTHON_PYOCD
	bool "python-pyocd"
	select BR2_PACKAGE_PYTHON_CMSIS_PACK_MANAGER # runtime
	select BR2_PACKAGE_PYTHON_COLORAMA # runtime
	#select BR2_PACKAGE_PYTHON_ENUM34 # runtime
	select BR2_PACKAGE_PYTHON_HIDAPI # runtime
	select BR2_PACKAGE_PYTHON_INTELHEX # runtime
	select BR2_PACKAGE_PYTHON_INTERVALTREE # runtime
	select BR2_PACKAGE_PYTHON_PRETTYTABLE # runtime
	select BR2_PACKAGE_PYTHON_PYELFTOOLS # runtime
	select BR2_PACKAGE_PYTHON_PYUSB # runtime
	select BR2_PACKAGE_PYTHON_PYWINUSB # runtime
	select BR2_PACKAGE_PYTHON_PYYAML # runtime
	select BR2_PACKAGE_PYTHON_SIX # runtime
	select BR2_PACKAGE_PYTHON_LIBUSB1 # runtime
	help
	  Cortex-M debugger for Python.

	  https://github.com/mbedmicro/pyOCD
```

## package/yubico_piv_tool/Config.in
```kconfig
config BR2_PACKAGE_YUBICO_PIV_TOOL
	bool "yubico_piv_tool"
  select BR2_PACKAGE_LIBTOOL
  select BR2_PACKAGE_CHECK
  select BR2_PACKAGE_CCID
  select BR2_PACKAGE_PCSC_LITE
	help
	   The Yubico PIV tool is used for interacting with the Privilege and Identification Card (PIV) application on a YubiKey.
```

## packages/mipi_dsi_ili9881d/Config.in
```kconfig
config BR2_PACKAGE_MIPI_DSI_ILI9881D
	bool "mipi_dsi_ili9881d"
	depends on BR2_LINUX_KERNEL
	help
		See README.adoc
```
